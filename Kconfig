## Kconfig
```kconfig
###############################################################################
# SPDX-License-Identifier: GPL-3.0-or-later
###############################################################################

mainmenu "USB interface App Configuration"

  menu "Compiler"
    config CROSS_COMPILE
	    string "Cross-compiler tool prefix"
      default "arm-none-eabi-"
	    help
	      Same as running 'make CROSS_COMPILE=prefix-' but stored for
	      default make runs in this application build directory.  You don't
	      need to set this unless you want the configured application build
	      directory to select the cross-compiler automatically.
    
    source "scripts/menu/compiler/ChoiceCDebugLevel"
    source "scripts/menu/compiler/ChoiceCLanguageStandard"
    source "scripts/menu/compiler/ChoiceCOptimizationLevel"
    source "scripts/menu/compiler/FlagCDataSections"
    source "scripts/menu/compiler/FlagCFunctionSections"
    source "scripts/menu/compiler/FlagCStackUsage"
    source "scripts/menu/compiler/FlagCWarnAll"
    source "scripts/menu/compiler/FlagCWarnError"
    source "scripts/menu/compiler/FlagCWarnExtra"
    source "scripts/menu/compiler/FlagCWarnNoUnusedParameter"
    source "scripts/menu/compiler/FlagCWarnSwitchDefault"
    source "scripts/menu/compiler/FlagCWarnSwitchEnum"
    source "scripts/menu/compiler/FlagUsePrintfFloat"
    source "scripts/menu/compiler/FlagUseScanfFloat"
  endmenu

  menu "Application"

  endmenu

###############################################################################
```
